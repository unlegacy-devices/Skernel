## arch/arm/mach-msm/lge/e0_porting/Kconfig
```kconfig
config MACH_MSM7X25A_E0EU
    depends on ARCH_MSM7X27A
    depends on !MSM_STACKED_MEMORY
    select MACH_LGE
    bool "MSM7x25A E0EU"
    help
        Support for the LG Electronics MSM7x25A E0EUOPEN.

config LGE_BATTERY_SUSPEND_RESUME
    depends on ARCH_MSM7X27A
    select MACH_LGE
    bool "MSM7x25A E0EU Battery Suspend"
    help
        Support for the LG Electronics Power.
```
